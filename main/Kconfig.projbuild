## main/Kconfig.projbuild
```kconfig
menu "Arduino subsystem serial logging"
  config ARDUINO_USE_USB_JTAG
    depends on !IDF_TARGET_ESP32
    bool "Output serial log via the USB/JTAG controller"
    default n
  config INIT_ARDU_SERIAL_LOGGING
    bool "Initialize serial logging for the Arduino subsystem and by extent for HomeSpan"
    default y
endmenu

menu "XIAO ESP32C6 antenna"
    depends on IDF_TARGET_ESP32C6
config XIAO_ESP32C6_RF_SWITCH
    bool "Drive the Seeed XIAO ESP32C6 RF switch (GPIO3 low, GPIO14 selects antenna)"
    default y
    help
        The XIAO ESP32C6 routes its antenna through an RF switch: GPIO3 low enables
        it and GPIO14 picks the antenna. Seeed's Arduino board package sets both;
        this firmware uses the generic esp32c6 variant, which leaves them floating
        and the radio badly attenuated. Turn off on other ESP32-C6 boards.
config XIAO_ESP32C6_EXTERNAL_ANTENNA
    bool "Use the U.FL connector instead of the built-in ceramic antenna"
    depends on XIAO_ESP32C6_RF_SWITCH
    default n
endmenu

menu "Yale BLE lock"
config YALE_BLE_LISTEN
    bool "Listen for the lock's advertisements and read its state on change (experimental)"
    default n
    help
        Short passive scan bursts (about 5% of the time) for the lock's Yale and
        HomeKit advertisements. A change triggers a status read (lock, door,
        battery). Bursts never run during a tap or while the lock link is up.
        Under test: one radio serves Wi-Fi, ESP-NOW and BLE.
endmenu
```
